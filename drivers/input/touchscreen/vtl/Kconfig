## drivers/input/touchscreen/vtl/Kconfig
```kconfig
#
# modular VTL Tech CT36X Driver
#

menuconfig TOUCHSCREEN_CT360_IIC
	tristate "Modular VTL Tech CT36x Driver"
	help
	  Enable support for the modular ISDN driver.

choice

    depends on TOUCHSCREEN_CT360_IIC
	prompt  "Touchscreen Chip Selection"

	config CT360_CHIP_VER
		bool "CT360"

	config CT363_CHIP_VER
		bool "CT363/CT365"

endchoice

	config TOUCH_MAX_X
                int "touch max x resolution"
                depends on TOUCHSCREEN_CT360_IIC
                default 1024
                help
                  CT36x touch max X resolution

    config TOUCH_MAX_Y
                int "touch max y resolution"
                depends on TOUCHSCREEN_CT360_IIC
                default 600
                help
                  CT36x touch max X resolution


config CT360_CHIP_UPDATE_SUPPORT
	bool "Enable firmware update of CT36X"
	depends on TOUCHSCREEN_CT360_IIC
	default n
	help
	  Enable Support of flashing new firmware to selected VTL chip.
	  A valid image must be provided.
	
config CHIP_DRIVER_FILE
	string "Firmware Image Blob Name"
	depends on TOUCHSCREEN_CT360_IIC && CT360_CHIP_UPDATE_SUPPORT
	default "CT360_ODYS_GENIO.DAT"
	help
	  Filename of the firmware image of the chip.
	
```
